## CMakeLists.txt
```
#
# gp-nrf-ble-blinky
# Copyright (c) 2023, Greg PFISTER. MIT Licennse
#
# THE SOFTWARE IS PROVIDED "AS IS", WITHOUT WARRANTY OF ANY KIND, EXPRESS OR
# IMPLIED, INCLUDING BUT NOT LIMITED TO THE WARRANTIES OF MERCHANTABILITY,
# FITNESS FOR A PARTICULAR PURPOSE AND NONINFRINGEMENT.IN NO EVENT SHALL THE
# AUTHORS OR COPYRIGHT HOLDERS BE LIABLE FOR ANY CLAIM, DAMAGES OR OTHER
# LIABILITY, WHETHER IN AN ACTION OF CONTRACT, TORT OR OTHERWISE, ARISING FROM,
# OUT OF OR IN CONNECTION WITH THE SOFTWARE OR THE USE OR OTHER DEALINGS IN THE
# SOFTWARE.
#

# cmake minimal version
cmake_minimum_required(VERSION 3.20.0)

# Zephy package
find_package(Zephyr REQUIRED HINTS $ENV{ZEPHYR_BASE})

# Project name
project(gp-nrf-ble-blinky)

# Target
target_sources(app PRIVATE src/main.c)
```

## Kconfig
```
#
# gp-nrf-ble-blinky
# Copyright (c) 2023, Greg PFISTER. MIT Licennse
#
# THE SOFTWARE IS PROVIDED "AS IS", WITHOUT WARRANTY OF ANY KIND, EXPRESS OR
# IMPLIED, INCLUDING BUT NOT LIMITED TO THE WARRANTIES OF MERCHANTABILITY,
# FITNESS FOR A PARTICULAR PURPOSE AND NONINFRINGEMENT.IN NO EVENT SHALL THE
# AUTHORS OR COPYRIGHT HOLDERS BE LIABLE FOR ANY CLAIM, DAMAGES OR OTHER
# LIABILITY, WHETHER IN AN ACTION OF CONTRACT, TORT OR OTHERWISE, ARISING FROM,
# OUT OF OR IN CONNECTION WITH THE SOFTWARE OR THE USE OR OTHER DEALINGS IN THE
# SOFTWARE.
#

# This file is the application Kconfig entry point. All application Kconfig
# options can be defined here or included via other application Kconfig files.
# You can browse these options using the west targets menuconfig (terminal) or
# guiconfig (GUI).

mainmenu "Greg's nRF BLE Bliny"

module = APP
module-str = App
source "subsys/logging/Kconfig.template.log_config"

menu "Zephyr"
source "Kconfig.zephyr"
endmenu
```

## sample.yaml
```
#
# gp-nrf-ble-blinky
# Copyright (c) 2023, Greg PFISTER. MIT Licennse
#
# THE SOFTWARE IS PROVIDED "AS IS", WITHOUT WARRANTY OF ANY KIND, EXPRESS OR
# IMPLIED, INCLUDING BUT NOT LIMITED TO THE WARRANTIES OF MERCHANTABILITY,
# FITNESS FOR A PARTICULAR PURPOSE AND NONINFRINGEMENT.IN NO EVENT SHALL THE
# AUTHORS OR COPYRIGHT HOLDERS BE LIABLE FOR ANY CLAIM, DAMAGES OR OTHER
# LIABILITY, WHETHER IN AN ACTION OF CONTRACT, TORT OR OTHERWISE, ARISING FROM,
# OUT OF OR IN CONNECTION WITH THE SOFTWARE OR THE USE OR OTHER DEALINGS IN THE
# SOFTWARE.
#

# This file is provided so that the application can be compiled using Twister,
# the Zephyr testing tool. In this file, multiple combinations can be specified,
# so that you can easily test all of them locally or in CI.
sample:
  description: Greg's nRF BLE Blinky
  name: gp-nrf-ble-blinky
common:
  build_only: true
  integration_platforms:
    - nrf52840dk_nrf52840
    - nrf52840dongle_nrf52840
tests:
  app.default: {}
  app.debug:
    extra_overlay_confs:
      - debug.conf
```

## prj.conf
```kconfig
#
# gp-nrf-ble-blinky
# Copyright (c) 2023, Greg PFISTER. MIT Licennse
#
# THE SOFTWARE IS PROVIDED "AS IS", WITHOUT WARRANTY OF ANY KIND, EXPRESS OR
# IMPLIED, INCLUDING BUT NOT LIMITED TO THE WARRANTIES OF MERCHANTABILITY,
# FITNESS FOR A PARTICULAR PURPOSE AND NONINFRINGEMENT.IN NO EVENT SHALL THE
# AUTHORS OR COPYRIGHT HOLDERS BE LIABLE FOR ANY CLAIM, DAMAGES OR OTHER
# LIABILITY, WHETHER IN AN ACTION OF CONTRACT, TORT OR OTHERWISE, ARISING FROM,
# OUT OF OR IN CONNECTION WITH THE SOFTWARE OR THE USE OR OTHER DEALINGS IN THE
# SOFTWARE.
#

# BLE Driver
CONFIG_BLE_DRIVER=y

# Led Driver
CONFIG_LED_DRIVER=y
CONFIG_LED_DRIVER_BLINKY=y
CONFIG_LED_DRIVER_BT_STATUS=y

# GPIO
CONFIG_GPIO=y

# RTT
CONFIG_USE_SEGGER_RTT=y

# Logging
CONFIG_LOG=y
CONFIG_LOG_BACKEND_RTT=y
# CONFIG_LOG_BACKEND_UART=y

# Debugging
CONFIG_ASSERT=y

# Enable Bluetooth
CONFIG_BT=y
CONFIG_BT_PERIPHERAL=y
CONFIG_BT_DEVICE_NAME="Greg's nRF BLE Blinky"
CONFIG_BT_DEVICE_APPEARANCE=0
CONFIG_BT_MAX_CONN=1
CONFIG_BT_LL_SOFTDEVICE=y
CONFIG_BT_LOG_LEVEL_OFF=y

# Entropy device
CONFIG_ENTROPY_DEVICE_RANDOM_GENERATOR=y
```

## debug.conf
```kconfig
#
# gp-nrf-ble-blinky
# Copyright (c) 2023, Greg PFISTER. MIT Licennse
#
# THE SOFTWARE IS PROVIDED "AS IS", WITHOUT WARRANTY OF ANY KIND, EXPRESS OR
# IMPLIED, INCLUDING BUT NOT LIMITED TO THE WARRANTIES OF MERCHANTABILITY,
# FITNESS FOR A PARTICULAR PURPOSE AND NONINFRINGEMENT.IN NO EVENT SHALL THE
# AUTHORS OR COPYRIGHT HOLDERS BE LIABLE FOR ANY CLAIM, DAMAGES OR OTHER
# LIABILITY, WHETHER IN AN ACTION OF CONTRACT, TORT OR OTHERWISE, ARISING FROM,
# OUT OF OR IN CONNECTION WITH THE SOFTWARE OR THE USE OR OTHER DEALINGS IN THE
# SOFTWARE.
#

# BLE Driver
CONFIG_BLE_DRIVER_LOG_LEVEL_DBG=y

# Led Driver
CONFIG_LED_DRIVER_LOG_LEVEL_DBG=y

# Compiler
CONFIG_DEBUG_OPTIMIZATIONS=y

# Segger RTT
CONFIG_USE_SEGGER_RTT=y

# Logging
CONFIG_LOG_BACKEND_RTT=y
CONFIG_LOG_BACKEND_UART=y

# Debugging
CONFIG_ASSERT=y

# BT Logging
CONFIG_BT_LOG_LEVEL_OFF=y
```

## nrf52840dk_nrf52840.overlay
```dts
//
// gp-nrf-ble-blinky
// Copyright (c) 2023, Greg PFISTER. MIT Licennse
//
// THE SOFTWARE IS PROVIDED "AS IS", WITHOUT WARRANTY OF ANY KIND, EXPRESS OR
// IMPLIED, INCLUDING BUT NOT LIMITED TO THE WARRANTIES OF MERCHANTABILITY,
// FITNESS FOR A PARTICULAR PURPOSE AND NONINFRINGEMENT.IN NO EVENT SHALL THE
// AUTHORS OR COPYRIGHT HOLDERS BE LIABLE FOR ANY CLAIM, DAMAGES OR OTHER
// LIABILITY, WHETHER IN AN ACTION OF CONTRACT, TORT OR OTHERWISE, ARISING FROM,
// OUT OF OR IN CONNECTION WITH THE SOFTWARE OR THE USE OR OTHER DEALINGS IN THE
// SOFTWARE.
//

/ {
	// Define led aliases
	aliases {
		ledblinky = &led0;		// Blinky led
		ledble = &led1;			// BT Led (off: disconnected / Blue: connected)
	};
};
```

## nrf52840dongle_nrf52840.overlay
```dts
//
// gp-nrf-ble-blinky
// Copyright (c) 2023, Greg PFISTER. MIT Licennse
//
// THE SOFTWARE IS PROVIDED "AS IS", WITHOUT WARRANTY OF ANY KIND, EXPRESS OR
// IMPLIED, INCLUDING BUT NOT LIMITED TO THE WARRANTIES OF MERCHANTABILITY,
// FITNESS FOR A PARTICULAR PURPOSE AND NONINFRINGEMENT.IN NO EVENT SHALL THE
// AUTHORS OR COPYRIGHT HOLDERS BE LIABLE FOR ANY CLAIM, DAMAGES OR OTHER
// LIABILITY, WHETHER IN AN ACTION OF CONTRACT, TORT OR OTHERWISE, ARISING FROM,
// OUT OF OR IN CONNECTION WITH THE SOFTWARE OR THE USE OR OTHER DEALINGS IN THE
// SOFTWARE.
//

/ {
	// Define led aliases
	aliases {
		ledblinky = &led0_green;	// Blinky led
		ledbtstatus = &led1_blue;	// BT Led (off: disconnected / Blue: connected)
	};
};
```

## src/main.c
```c
//
// gp-nrf-ble-blinky
// Copyright (c) 2023, Greg PFISTER. MIT Licennse
//
// THE SOFTWARE IS PROVIDED "AS IS", WITHOUT WARRANTY OF ANY KIND, EXPRESS OR
// IMPLIED, INCLUDING BUT NOT LIMITED TO THE WARRANTIES OF MERCHANTABILITY,
// FITNESS FOR A PARTICULAR PURPOSE AND NONINFRINGEMENT.IN NO EVENT SHALL THE
// AUTHORS OR COPYRIGHT HOLDERS BE LIABLE FOR ANY CLAIM, DAMAGES OR OTHER
// LIABILITY, WHETHER IN AN ACTION OF CONTRACT, TORT OR OTHERWISE, ARISING FROM,
// OUT OF OR IN CONNECTION WITH THE SOFTWARE OR THE USE OR OTHER DEALINGS IN THE
// SOFTWARE.
//

#include <zephyr/kernel.h>
#include <zephyr/logging/log.h>

#include <app_version.h>
#include <drivers/ble.h>
#include <drivers/led.h>

/* Logger *********************************************************************/

LOG_MODULE_REGISTER(APP, CONFIG_LOG_DEFAULT_LEVEL);

/* Declarations ***************************************************************/

void printInfo();
void on_blinky_led_selected_sequence_changed_cb(const uint8_t *led_sequence);
void on_blinky_led_status_changed_cb(const uint8_t *led_status);
void on_ble_central_connected_cb(const void *conn);
void on_ble_central_disconnected_cb(const void *conn);
const uint8_t *on_ble_central_read_blinky_led_selected_sequence_cb(const void *conn);
const uint8_t *on_ble_central_read_blinky_led_status_cb(const void *conn);
void on_ble_central_write_blinky_led_selected_sequence_cb(const void *conn, const uint8_t *led_sequence);

// /* Main ***********************************************************************/

int main(void)
{
    // Print informations about the app
    printInfo();

    // Define variables
    int ret;

    // Initialise the leds
    struct led_controller_cb led_controller_cb = {
        .on_blinky_led_selected_sequence_changed = on_blinky_led_selected_sequence_changed_cb,
        .on_blinky_led_status_changed = on_blinky_led_status_changed_cb,
    };
    ret = led_controller_init(&led_controller_cb);
    if (ret < 0) {
        return -1;
    }

    // Initializing BLE
    struct ble_controller_cb ble_controller_cb = {
        .on_connect = on_ble_central_connected_cb,
        .on_disconnect = on_ble_central_disconnected_cb,
        .on_read_blinky_led_selected_sequence = on_ble_central_read_blinky_led_selected_sequence_cb,
        .on_read_blinky_led_status = on_ble_central_read_blinky_led_status_cb,
        .on_write_blinky_led_selected_sequence = on_ble_central_write_blinky_led_selected_sequence_cb,
    };
    ret = ble_controller_init(&ble_controller_cb);
    if (ret < 0) {
        return -2;
    }

    // Main loop
    while (1) {
        ret = led_controller_run_sequence();
        if (ret < 0) {
            LOG_WRN("Exiting main loop because of an error");
            break;
        }
    }

    k_msleep(1000);
    return 0;
}

/* Informations ***************************************************************/

void printInfo()
{
    uint32_t ver = sys_kernel_version_get();
    LOG_INF("Welcome to BLE Blinky Peripheral");
    LOG_INF("Copyright (c) 2023, Greg PFISTER. MIT License.");
    LOG_INF("Firmware version: %s", APP_VERSION_STRING);
    LOG_INF("Target board: %s", CONFIG_BOARD);
    LOG_INF("Zephy Kernel version: %i.%i.%i", SYS_KERNEL_VER_MAJOR(ver), SYS_KERNEL_VER_MINOR(ver),
            SYS_KERNEL_VER_PATCHLEVEL(ver));
}

/* Led Controller Callbacks ***************************************************/

void on_blinky_led_selected_sequence_changed_cb(const uint8_t *led_sequence)
{
#if CONFIG_LED_DRIVER_BLE
    ble_controller_update_blinky_led_sequence_value(led_sequence);
#endif /* CONFIG_LED_DRIVER_BLE */
}

void on_blinky_led_status_changed_cb(const uint8_t *led_status)
{
#if CONFIG_LED_DRIVER_BLE
    ble_controller_update_blinky_led_status_value(led_status);
#endif /* CONFIG_LED_DRIVER_BLE */
}

/* BLE Controller Callbacks ***************************************************/

void on_ble_central_connected_cb(const void *conn)
{
    LOG_INF("BLE - Central device %p connected", (void *)conn);
    led_controller_set_bt_connected();
}

void on_ble_central_disconnected_cb(const void *conn)
{
    LOG_INF("Central device %p disconnected", (void *)conn);
    led_controller_unset_bt_connected();
}

const uint8_t *on_ble_central_read_blinky_led_selected_sequence_cb(const void *conn)
{
    LOG_INF("BLE - Central %p is reading selected blinky led sequence value", (void *)conn);
    return led_controller_get_selected_led_sequence();
}

const uint8_t *on_ble_central_read_blinky_led_status_cb(const void *conn)
{
    LOG_INF("BLE - Central %p is reading selected blinky led status", (void *)conn);
    return led_controller_get_led_status();
}

void on_ble_central_write_blinky_led_selected_sequence_cb(const void *conn, const uint8_t *led_sequence)
{
    LOG_INF("BLE - Central %p is setting new selected sequence for blinkty led: %i", (void *)conn, *led_sequence);
    led_controller_set_selected_led_sequence(led_sequence);
}
```
