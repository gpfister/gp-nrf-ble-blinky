## boards/arm/gp_nrf52840/Kconfig.board
```kconfig
#
# gp-nrf-ble-blinky
# Copyright (c) 2023, Greg PFISTER. MIT Licennse
#
# THE SOFTWARE IS PROVIDED "AS IS", WITHOUT WARRANTY OF ANY KIND, EXPRESS OR
# IMPLIED, INCLUDING BUT NOT LIMITED TO THE WARRANTIES OF MERCHANTABILITY,
# FITNESS FOR A PARTICULAR PURPOSE AND NONINFRINGEMENT.IN NO EVENT SHALL THE
# AUTHORS OR COPYRIGHT HOLDERS BE LIABLE FOR ANY CLAIM, DAMAGES OR OTHER
# LIABILITY, WHETHER IN AN ACTION OF CONTRACT, TORT OR OTHERWISE, ARISING FROM,
# OUT OF OR IN CONNECTION WITH THE SOFTWARE OR THE USE OR OTHER DEALINGS IN THE
# SOFTWARE.
#

config BOARD_GP_NRF52840
	bool "Greg's nRF52840"
	depends on SOC_NRF52840_QIAA
```

## boards/arm/ns_nrf52840_dk/Kconfig.board
```kconfig
#
# gp-nrf-ble-blinky
# Copyright (c) 2023, Greg PFISTER. MIT Licennse
#
# THE SOFTWARE IS PROVIDED "AS IS", WITHOUT WARRANTY OF ANY KIND, EXPRESS OR
# IMPLIED, INCLUDING BUT NOT LIMITED TO THE WARRANTIES OF MERCHANTABILITY,
# FITNESS FOR A PARTICULAR PURPOSE AND NONINFRINGEMENT.IN NO EVENT SHALL THE
# AUTHORS OR COPYRIGHT HOLDERS BE LIABLE FOR ANY CLAIM, DAMAGES OR OTHER
# LIABILITY, WHETHER IN AN ACTION OF CONTRACT, TORT OR OTHERWISE, ARISING FROM,
# OUT OF OR IN CONNECTION WITH THE SOFTWARE OR THE USE OR OTHER DEALINGS IN THE
# SOFTWARE.
#

config BOARD_NS_NRF52840_DK
	bool "NS nRF52840 DK"
	depends on SOC_NRF52840_QIAA
```

## boards/arm/ns_nrf52840_dk/ns_nrf52840_dk_defconfig
```kconfig
#
# gp-nrf52840-ble-blinky
# Copyright (c) 2023, Greg PFISTER. MIT Licennse
#
# THE SOFTWARE IS PROVIDED "AS IS", WITHOUT WARRANTY OF ANY KIND, EXPRESS OR
# IMPLIED, INCLUDING BUT NOT LIMITED TO THE WARRANTIES OF MERCHANTABILITY,
# FITNESS FOR A PARTICULAR PURPOSE AND NONINFRINGEMENT.IN NO EVENT SHALL THE
# AUTHORS OR COPYRIGHT HOLDERS BE LIABLE FOR ANY CLAIM, DAMAGES OR OTHER
# LIABILITY, WHETHER IN AN ACTION OF CONTRACT, TORT OR OTHERWISE, ARISING FROM,
# OUT OF OR IN CONNECTION WITH THE SOFTWARE OR THE USE OR OTHER DEALINGS IN THE
# SOFTWARE.
#

CONFIG_SOC_SERIES_NRF52X=y
CONFIG_SOC_NRF52840_QIAA=y
CONFIG_BOARD_NS_NRF52840_DK=y

# Enable MPU
CONFIG_ARM_MPU=y

# Enable hardware stack protection
CONFIG_HW_STACK_PROTECTION=y

# Enable GPIO
CONFIG_GPIO=y
```

## drivers/ble/Kconfig
```kconfig
#
# gp-nrf-ble-blinky
# Copyright (c) 2023, Greg PFISTER. MIT Licennse
#
# THE SOFTWARE IS PROVIDED "AS IS", WITHOUT WARRANTY OF ANY KIND, EXPRESS OR
# IMPLIED, INCLUDING BUT NOT LIMITED TO THE WARRANTIES OF MERCHANTABILITY,
# FITNESS FOR A PARTICULAR PURPOSE AND NONINFRINGEMENT.IN NO EVENT SHALL THE
# AUTHORS OR COPYRIGHT HOLDERS BE LIABLE FOR ANY CLAIM, DAMAGES OR OTHER
# LIABILITY, WHETHER IN AN ACTION OF CONTRACT, TORT OR OTHERWISE, ARISING FROM,
# OUT OF OR IN CONNECTION WITH THE SOFTWARE OR THE USE OR OTHER DEALINGS IN THE
# SOFTWARE.
#

menuconfig BLE_DRIVER
	bool "BLE Driver"
	default y
	# depends on DT_HAS_ZEPHYR_LED_ENABLED
	# select GPIO
	help
	  BLE Driver

if BLE_DRIVER

module = BLE_DRIVER
module-str = BLE Driver
source "subsys/logging/Kconfig.template.log_config"

endif
```

## drivers/led/Kconfig
```kconfig
#
# gp-nrf-ble-blinky
# Copyright (c) 2023, Greg PFISTER. MIT Licennse
#
# THE SOFTWARE IS PROVIDED "AS IS", WITHOUT WARRANTY OF ANY KIND, EXPRESS OR
# IMPLIED, INCLUDING BUT NOT LIMITED TO THE WARRANTIES OF MERCHANTABILITY,
# FITNESS FOR A PARTICULAR PURPOSE AND NONINFRINGEMENT.IN NO EVENT SHALL THE
# AUTHORS OR COPYRIGHT HOLDERS BE LIABLE FOR ANY CLAIM, DAMAGES OR OTHER
# LIABILITY, WHETHER IN AN ACTION OF CONTRACT, TORT OR OTHERWISE, ARISING FROM,
# OUT OF OR IN CONNECTION WITH THE SOFTWARE OR THE USE OR OTHER DEALINGS IN THE
# SOFTWARE.
#

menuconfig LED_DRIVER
	bool "Led Driver"
	default y
	# depends on DT_HAS_ZEPHYR_LED_DRIVER_ENABLED
	select GPIO
	help
	  Led Driver

if LED_DRIVER

config LED_DRIVER_BLINKY
	bool "Active the Blinky led"
	default y
	help
	  Blinks a led. It requires the led_blinky to be set on the device tree

config LED_DRIVER_BLE
	bool "Activate the BLE led"
	default y
	help
	  Use a led to display the BLE led (on: connected, off: disconnected). It 
	  requires the led_bt_status to be set on the device tree

module = LED_DRIVER
module-str = Led Driver
source "subsys/logging/Kconfig.template.log_config"

endif
```

## lib/custom_lib/Kconfig
```kconfig
#
# gp-nrf52840-ble-blinky
# Copyright (c) 2023, Greg PFISTER. MIT Licennse
#
# THE SOFTWARE IS PROVIDED "AS IS", WITHOUT WARRANTY OF ANY KIND, EXPRESS OR
# IMPLIED, INCLUDING BUT NOT LIMITED TO THE WARRANTIES OF MERCHANTABILITY,
# FITNESS FOR A PARTICULAR PURPOSE AND NONINFRINGEMENT.IN NO EVENT SHALL THE
# AUTHORS OR COPYRIGHT HOLDERS BE LIABLE FOR ANY CLAIM, DAMAGES OR OTHER
# LIABILITY, WHETHER IN AN ACTION OF CONTRACT, TORT OR OTHERWISE, ARISING FROM,
# OUT OF OR IN CONNECTION WITH THE SOFTWARE OR THE USE OR OTHER DEALINGS IN THE
# SOFTWARE.
#

config CUSTOM_LIB
	bool "custom_lib Support"
	help
	  This option enables the custom_lib library

config CUSTOM_LIB_GET_VALUE_DEFAULT
	int "custom_lib_get_value() default return value"
	depends on CUSTOM_LIB
	default 0
	help
	  This option primarily exists as an example of a library Kconfig
	  setting.

	  This option specifies the value for custom_lib_get_value()
	  to return when the input parameter is zero.  (Otherwise
	  the function returns the input parameter value.)
```

## tests/lib/custom_lib/testcase.yaml
```yaml
#
# gp-nrf52840-ble-blinky
# Copyright (c) 2023, Greg PFISTER. MIT Licennse
#
# THE SOFTWARE IS PROVIDED "AS IS", WITHOUT WARRANTY OF ANY KIND, EXPRESS OR
# IMPLIED, INCLUDING BUT NOT LIMITED TO THE WARRANTIES OF MERCHANTABILITY,
# FITNESS FOR A PARTICULAR PURPOSE AND NONINFRINGEMENT.IN NO EVENT SHALL THE
# AUTHORS OR COPYRIGHT HOLDERS BE LIABLE FOR ANY CLAIM, DAMAGES OR OTHER
# LIABILITY, WHETHER IN AN ACTION OF CONTRACT, TORT OR OTHERWISE, ARISING FROM,
# OUT OF OR IN CONNECTION WITH THE SOFTWARE OR THE USE OR OTHER DEALINGS IN THE
# SOFTWARE.
#

common:
  tags: extensibility
  integration_platforms:
    - nrf52840dk_nrf52840
    - qemu_cortex_m0
tests:
  lib.custom_lib: {}
  lib.custom_lib.non_default:
    extra_args: CONFIG_CUSTOM_LIB_GET_VALUE_DEFAULT=6
```
